## firmware/configs/stm32f072-serial/defconfig
```kconfig
CONFIG_LOW_LEVEL_OPTIONS=y
CONFIG_MACH_STM32=y
CONFIG_MACH_STM32F072=y
CONFIG_STM32_SERIAL_USART1=y
CONFIG_INITIAL_PINS="PA5"
```

## firmware/configs/stm32f103-angle/defconfig
```kconfig
CONFIG_LOW_LEVEL_OPTIONS=y
CONFIG_MACH_STM32=y
CONFIG_MACH_STM32F103=y
CONFIG_STM32_SERIAL_USART1=y
CONFIG_WANT_SENSOR_ANGLE=y
```

## firmware/configs/stm32f103-serial/defconfig
```kconfig
CONFIG_LOW_LEVEL_OPTIONS=y
CONFIG_MACH_STM32=y
CONFIG_MACH_STM32F103=y
CONFIG_STM32_FLASH_START_4000=y
CONFIG_STM32_SERIAL_USART1=y
CONFIG_INITIAL_PINS="PB13"
```

## firmware/configs/stm32f207-usb/defconfig
```kconfig
CONFIG_LOW_LEVEL_OPTIONS=y
CONFIG_MACH_STM32=y
CONFIG_MACH_STM32F207=y
CONFIG_INITIAL_PINS="PA5"
```

## firmware/configs/stm32f446-usb/defconfig
```kconfig
CONFIG_LOW_LEVEL_OPTIONS=y
CONFIG_MACH_STM32=y
CONFIG_MACH_STM32F446=y
CONFIG_STM32_CLOCK_REF_12M=y
CONFIG_INITIAL_PINS="PA5"
```

## firmware/configs/stm32f765-usb/defconfig
```kconfig
CONFIG_LOW_LEVEL_OPTIONS=y
CONFIG_MACH_STM32=y
CONFIG_MACH_STM32F765=y
CONFIG_INITIAL_PINS="PA5"
```

## firmware/configs/stm32g0b1-serial/defconfig
```kconfig
CONFIG_LOW_LEVEL_OPTIONS=y
CONFIG_MACH_STM32=y
CONFIG_MACH_STM32G0B1=y
CONFIG_STM32_SERIAL_USART2=y
CONFIG_INITIAL_PINS="PA5"
```

## firmware/configs/stm32h723-usb/defconfig
```kconfig
CONFIG_LOW_LEVEL_OPTIONS=y
CONFIG_MACH_STM32=y
CONFIG_MACH_STM32H723=y
CONFIG_STM32_CLOCK_REF_25M=y
CONFIG_INITIAL_PINS="PA5"
```

## firmware/configs/stm32h723-usbcan/defconfig
```kconfig
CONFIG_LOW_LEVEL_OPTIONS=y
CONFIG_MACH_STM32=y
CONFIG_MACH_STM32H723=y
CONFIG_STM32_CLOCK_REF_25M=y
CONFIG_STM32_USBCANBUS_PA11_PA12=y
CONFIG_STM32_CMENU_CANBUS_PD0_PD1=y
CONFIG_INITIAL_PINS="PA5"
```

## firmware/configs/stm32l412-usb/defconfig
```kconfig
CONFIG_LOW_LEVEL_OPTIONS=y
CONFIG_MACH_STM32=y
CONFIG_MACH_STM32L412=y
CONFIG_INITIAL_PINS="PA5"
```
