## firmware/configs/atmega168-serial/defconfig
```kconfig
CONFIG_MACH_atmega168=y
# CONFIG_WANT_SOFTWARE_SPI is not set
# CONFIG_WANT_SOFTWARE_I2C is not set
# CONFIG_WANT_HARD_PWM is not set
# CONFIG_WANT_TMCUART is not set
# CONFIG_WANT_NEOPIXEL is not set
# CONFIG_WANT_PULSE_COUNTER is not set
# CONFIG_WANT_ST7920 is not set
# CONFIG_WANT_HD44780 is not set
# CONFIG_WANT_HX71X is not set
# CONFIG_WANT_CS1237 is not set
# CONFIG_WANT_GPIO_SPI is not set
# CONFIG_WANT_GPIO_I2C is not set
```

## firmware/configs/atmega328p-serial/defconfig
```kconfig
CONFIG_MACH_atmega328p=y
# CONFIG_WANT_SOFTWARE_SPI is not set
# CONFIG_WANT_SOFTWARE_I2C is not set
# CONFIG_WANT_TMCUART is not set
# CONFIG_WANT_NEOPIXEL is not set
# CONFIG_WANT_PULSE_COUNTER is not set
# CONFIG_WANT_ST7920 is not set
# CONFIG_WANT_HD44780 is not set
# CONFIG_WANT_ADXL345 is not set
# CONFIG_WANT_LIS2DW is not set
# CONFIG_WANT_MPU9250 is not set
# CONFIG_WANT_ICM20948 is not set
# CONFIG_WANT_THERMOCOUPLE is not set
# CONFIG_WANT_HX71X is not set
# CONFIG_WANT_ADS1220 is not set
# CONFIG_WANT_ADS131M0X is not set
# CONFIG_WANT_CS1237 is not set
# CONFIG_WANT_LDC1612 is not set
```

## firmware/configs/rp2040-serial/defconfig
```kconfig
CONFIG_LOW_LEVEL_OPTIONS=y
CONFIG_MACH_RPXXXX=y
CONFIG_RPXXXX_SERIAL_UART0_PINS_0_1=y
```

## firmware/configs/samc21g18-can/defconfig
```kconfig
CONFIG_MACH_ATSAMD=y
CONFIG_SAMD_FLASH_START_0000=y
CONFIG_ATSAMD_MMENU_CANBUS_PB11_PB10=y
```

## firmware/configs/same51j19-indx/defconfig
```kconfig
CONFIG_LOW_LEVEL_OPTIONS=y
CONFIG_MACH_ATSAMD=y
CONFIG_MACH_SAME51J19=y
CONFIG_CLOCK_REF_X25M_XOSC0=y
CONFIG_WANT_INDX_HEATER=y
```

## firmware/configs/same70q20b-can/defconfig
```kconfig
CONFIG_MACH_ATSAM=y
CONFIG_MACH_SAME70Q20B=y
CONFIG_ATSAM_MMENU_CANBUS_PC12_PD12=y
```

## firmware/configs/same70q20b-usbcan/defconfig
```kconfig
CONFIG_MACH_ATSAM=y
CONFIG_MACH_SAME70Q20B=y
CONFIG_ATSAM_USBCANBUS=y
CONFIG_ATSAM_CMENU_CANBUS_PB3_PB2=y
```
